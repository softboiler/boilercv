## conf/stage/sample.yaml
```yaml
compare_with_trackpy: "--compare-with-trackpy"
display_rows: 12
frame_count: 500
frame_step: 1
guess_diameter: 21
load_src_from_outs: "--no-load-src-from-outs"
marker_scale: 20.0
only_sample: "--only-sample"
precision: 3
sample: "2024-07-18T17-44-35"
scale: 1.3
```
